## sdkconfig.defaults
```kconfig
CONFIG_BOOTLOADER_APP_ROLLBACK_ENABLE=y
CONFIG_ESPTOOLPY_FLASHSIZE_4MB=y
CONFIG_PARTITION_TABLE_CUSTOM=y
CONFIG_HTTPD_WS_SUPPORT=y
CONFIG_LWIP_LOCAL_HOSTNAME="ledriver"
```
